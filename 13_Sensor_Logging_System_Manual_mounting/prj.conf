## CMakeLists.txt
```
cmake_minimum_required(VERSION 3.20.0)
find_package(Zephyr REQUIRED HINTS $ENV{ZEPHYR_BASE})
project(13_Sensor_Logging_System_Manual_mounting)

FILE(GLOB app_sources src/*.c)
target_sources(app PRIVATE ${app_sources})
```

## prj.conf
```kconfig
CONFIG_I2C=y
CONFIG_SENSOR=y
CONFIG_CBPRINTF_FP_SUPPORT=y
CONFIG_LOG=y

CONFIG_MAIN_STACK_SIZE=8192
CONFIG_FLASH=y
CONFIG_FLASH_MAP=y
CONFIG_FILE_SYSTEM=y
CONFIG_FILE_SYSTEM_LITTLEFS=y
CONFIG_FILE_SYSTEM_SHELL=y
```

## src/imu_sensor.c
```c
/*
 * @file imu_sensor.c
 * @author Dhruv Mamtora
 * @version 0.1.0
 * @date  27 August, 2025
 *
 * @brief This file contains functions to interface with the LSM6DSL IMU sensor.
 *
 * @details
 * This file implements functions to initialize the LSM6DSL IMU sensor, read accelerometer
 * and gyroscope data, and send the data to a logger thread via a message queue.
 *
 * @copyright Copyright (c) 2025
 */

/** REQUIRED HEADER FILES */
#include <zephyr/device.h>
#include <zephyr/drivers/sensor.h>
#include <zephyr/kernel.h>
#include <zephyr/logging/log.h>

#include "sensor_structures.h"

/** MACRO DEFINITIONS */
#define IMU_SENSOR_THREAD_STACK_SIZE 1024
#define IMU_SENSOR_THREAD_PRIORITY   5
#define IMU_SENSOR_THREAD_SLEEP_TIME K_SECONDS(30)

#define IMU_Q_MAX_MSGS 10
#define IMU_Q_ALIGN    32

#define IMU_Q_TIMEOUT K_MSEC(1000)

/** DEVICE CONFIGURATION */
/* Check if the LSM6DSL sensor is defined in the device tree. */
#if DT_NODE_EXISTS(DT_ALIAS(imu_sensor))
#define IMU_NODE DT_ALIAS(imu_sensor)
const struct device *const imuDev = DEVICE_DT_GET(DT_ALIAS(imu_sensor));
#else
#error ("IMU sensor not found.");
#endif

/* Function prototypes */
void imuSensorThread(void *a, void *b, void *c);
int imuSensorProcess(motionData_t *motionDataStruct);

/** LOGGING CONFIGURATION */
/* Register the logging module for IMU sensor operations. */
LOG_MODULE_REGISTER(imu);

/* Message queue to send IMU data to the logger thread */
K_MSGQ_DEFINE(imuMsgQ, sizeof(motionData_t), IMU_Q_MAX_MSGS, IMU_Q_ALIGN);

/*
 * @brief imuSensorProcess - Process IMU sensor data.
 *
 * @author Dhruv Mamtora
 * @date 27 August, 2025
 *
 * @details
 * This function reads data from the LSM6DSL IMU sensor and updates the provided motionDataStruct
 * with the latest accelerometer and gyroscope values.
 *
 * @pre The IMU sensor device must be initialized and ready.
 *
 * @syntax
 * int imuSensorProcess(motionData_t *motionDataStruct);
 *
 * @param[in] motionDataStruct Pointer to the structure to store the latest motion data.
 * @param[out] motionDataStruct->accel Updated with the latest accelerometer data.
 * @param[out] motionDataStruct->gyro Updated with the latest gyroscope data.
 *
 * @return 0 on success, -1 on failure.
 *
 * @retval 0 Success
 * @retval -1 Error
 */
int imuSensorProcess(motionData_t *motionDataStruct)
{

	if (!device_is_ready(imuDev)) {
		LOG_ERR("sensor: %s device not ready.", imuDev->name);
		return -1;
	}

	struct sensor_value odr_attr;

	/* set accel/gyro sampling frequency to 104 Hz */
	odr_attr.val1 = 104;
	odr_attr.val2 = 0;

	if (sensor_attr_set(imuDev, SENSOR_CHAN_ACCEL_XYZ, SENSOR_ATTR_SAMPLING_FREQUENCY,
			    &odr_attr) < 0) {
		LOG_ERR("Cannot set sampling frequency for accelerometer.");
		return -1;
	}

	if (sensor_attr_set(imuDev, SENSOR_CHAN_GYRO_XYZ, SENSOR_ATTR_SAMPLING_FREQUENCY,
			    &odr_attr) < 0) {
		LOG_ERR("Cannot set sampling frequency for gyro.");
		return -1;
	}

	if (sensor_sample_fetch(imuDev) < 0) {
		LOG_ERR("Sensor sample update error");
		return -1;
	}

	struct sensor_value accel_x, accel_y, accel_z;
	struct sensor_value gyro_x, gyro_y, gyro_z;

	/* Fetch accelerometer data */
	if (sensor_sample_fetch_chan(imuDev, SENSOR_CHAN_ACCEL_XYZ) < 0) {
		LOG_ERR("Accelerometer Sensor sample update error");
		return -1;
	}
	sensor_channel_get(imuDev, SENSOR_CHAN_ACCEL_X, &accel_x);
	sensor_channel_get(imuDev, SENSOR_CHAN_ACCEL_Y, &accel_y);
	sensor_channel_get(imuDev, SENSOR_CHAN_ACCEL_Z, &accel_z);

	motionDataStruct->accel.x = sensor_value_to_double(&accel_x);
	motionDataStruct->accel.y = sensor_value_to_double(&accel_y);
	motionDataStruct->accel.z = sensor_value_to_double(&accel_z);

	/* Fetch gyroscope data */
	if (sensor_sample_fetch_chan(imuDev, SENSOR_CHAN_GYRO_XYZ) < 0) {
		LOG_ERR("Gyroscope Sensor sample update error");
		return -1;
	}
	sensor_channel_get(imuDev, SENSOR_CHAN_GYRO_X, &gyro_x);
	sensor_channel_get(imuDev, SENSOR_CHAN_GYRO_Y, &gyro_y);
	sensor_channel_get(imuDev, SENSOR_CHAN_GYRO_Z, &gyro_z);

	motionDataStruct->gyro.x = sensor_value_to_double(&gyro_x);
	motionDataStruct->gyro.y = sensor_value_to_double(&gyro_y);
	motionDataStruct->gyro.z = sensor_value_to_double(&gyro_z);

	return 0;
}

/*
 * @brief imuSensorThread - Thread to periodically read IMU sensor data.
 *
 * @author Dhruv Mamtora
 * @date 27 August, 2025
 *
 * @details
 * This thread function continuously reads data from the LSM6DSL IMU sensor at defined intervals
 * and sends the data to the logger thread via a message queue.
 *
 * @syntax
 * void imuSensorThread(void *a, void *b, void *c);
 *
 * @param[in] a Unused parameter.
 * @param[in] b Unused parameter.
 * @param[in] c Unused parameter.
 */
void imuSensorThread(void *a, void *b, void *c)
{
	motionData_t motionDataStruct;

	LOG_INF("IMU sensor thread started.");

	while (1) {
		if (imuSensorProcess(&motionDataStruct) == 0) {
			/* Send the motion data to the logger thread via message queue */
			if (k_msgq_put(&imuMsgQ, &motionDataStruct, IMU_Q_TIMEOUT) != 0) {
				LOG_WRN("IMU message queue full, dropping data");
			}
		}
		k_sleep(IMU_SENSOR_THREAD_SLEEP_TIME);
	}

	/* This line will never be reached */
	LOG_INF("IMU sensor thread stopped.");
}

/* Define the IMU sensor thread */
K_THREAD_DEFINE(imuSensorThreadId, IMU_SENSOR_THREAD_STACK_SIZE, imuSensorThread, NULL, NULL, NULL,
		IMU_SENSOR_THREAD_PRIORITY, 0, 2000);
```

## src/pressure_sensor.c
```c
/*
 * @file pressure_sensor.c
 * @author Dhruv Mamtora
 * @version 0.1.0
 * @date  27 August, 2025
 *
 * @brief Pressure sensor operations for the Sensor Data Logging System.
 *
 * @details
 * This file contains the implementation of the pressure sensor thread, which reads data from
 * the LPS22HH sensor and sends the pressure data to the logger thread via a message queue
 * for logging.
 *
 * @copyright Copyright (c) 2025
 */

/** REQUIRED HEADER FILES */
#include <zephyr/device.h>
#include <zephyr/drivers/sensor.h>
#include <zephyr/kernel.h>
#include <zephyr/logging/log.h>

#include "sensor_structures.h"

/** MACRO DEFINITIONS */
#define PRESSURE_SENSOR_THREAD_STACK_SIZE 512
#define PRESSURE_SENSOR_THREAD_PRIORITY   5
#define PRESSURE_SENSOR_THREAD_SLEEP_TIME K_SECONDS(30)

#define PRESSURE_Q_MAX_MSGS 10
#define PRESSURE_Q_ALIGN    32

#define PRESSURE_Q_TIMEOUT K_MSEC(1000)

/** DEVICE CONFIGURATION */
/* Check if the LPS22HH sensor is defined in the device tree. */
#if DT_NODE_EXISTS(DT_ALIAS(pressure_sensor))
#define PRESSURE_NODE DT_ALIAS(pressure_sensor)
const struct device *const pressureDev = DEVICE_DT_GET(DT_ALIAS(pressure_sensor));
#else
#error ("Pressure sensor not found.");
#endif

/* Function prototypes */
void pressureSensorThread(void *a, void *b, void *c);
int pressureSensorProcess(pressureData_t *pressureDataStruct);

/** LOGGING CONFIGURATION */
/* Register the logging module for pressure sensor operations. */
LOG_MODULE_REGISTER(pressure);

/* Message queue to send pressure data to the logger thread */
K_MSGQ_DEFINE(pressureMsgQ, sizeof(pressureData_t), PRESSURE_Q_MAX_MSGS, PRESSURE_Q_ALIGN);

/*
 * @brief pressureSensorProcess - Process pressure sensor data.
 *
 * @author Dhruv Mamtora
 * @date 27 August, 2025
 *
 * @details
 * This function reads data from the LPS22HH pressure sensor and updates the provided
 * pressureDataStruct with the latest pressure value.
 *
 * @pre The sensor device must be initialized and ready.
 *
 * @syntax
 * int pressureSensorProcess(pressureData_t *pressureDataStruct);
 *
 * @param[in] pressureDataStruct Pointer to the structure to store the latest pressure value.
 * @param[out] pressureDataStruct->dPressure Updated with the latest pressure value in hPa.
 *
 * @return 0 on success, -1 on failure.
 *
 * @retval 0 Success
 * @retval -1 Error
 */
int pressureSensorProcess(pressureData_t *pressureDataStruct)
{
	if (!device_is_ready(pressureDev)) {
		LOG_ERR("sensor: %s device not ready.", pressureDev->name);
		return -1;
	}

	if (sensor_sample_fetch(pressureDev) < 0) {
		LOG_ERR("Sensor sample update error");
		return -1;
	}

	struct sensor_value pressure;
	if (sensor_channel_get(pressureDev, SENSOR_CHAN_PRESS, &pressure) < 0) {
		LOG_ERR("Cannot read pressure channel");
		return -1;
	}

	pressureDataStruct->dPressure = sensor_value_to_double(&pressure);
	return 0;
}

/*
 * @brief pressureSensorThread - Thread to periodically read pressure sensor data.
 *
 * @author Dhruv Mamtora
 * @date 27 August, 2025
 *
 * @details
 * This thread function continuously reads data from the LPS22HH pressure sensor at defined
 * intervals and sends the data to the logger thread via a message queue.
 *
 * @syntax
 * void pressureSensorThread(void *a, void *b, void *c);
 *
 * @param[in] a Unused parameter.
 * @param[in] b Unused parameter.
 * @param[in] c Unused parameter.
 */
void pressureSensorThread(void *a, void *b, void *c)
{
	pressureData_t pressureDataStruct;

	LOG_INF("Pressure sensor thread started.");
	while (1) {
		if (pressureSensorProcess(&pressureDataStruct) == 0) {
			/* Send the pressure data to the logger thread */
			if (k_msgq_put(&pressureMsgQ, &pressureDataStruct, PRESSURE_Q_TIMEOUT) !=
			    0) {
				LOG_WRN("Pressure message queue full, dropping data.");
			}
		}
		k_sleep(PRESSURE_SENSOR_THREAD_SLEEP_TIME);
	}

	/* This line will never be reached */
	LOG_INF("Pressure sensor thread stopped.");
}

/* Define and start the pressure sensor thread */
K_THREAD_DEFINE(pressureSensorThreadId, PRESSURE_SENSOR_THREAD_STACK_SIZE, pressureSensorThread,
		NULL, NULL, NULL, PRESSURE_SENSOR_THREAD_PRIORITY, 0, 2000);
```

## src/sensor_logger.c
```c
/*
 * @file sensor_logger.c
 * @author Dhruv Mamtora
 * @version 0.1.0
 * @date  26 August, 2025
 *
 * @brief Sensor logger thread implementation.
 *
 * @details
 * This file contains the implementation of the sensor logger thread, which is responsible for
 * receiving sensor data from various sensor threads and logging it. The logger thread uses a
 * message queue to receive data from the humidity sensor thread.
 *
 * @copyright Copyright (c) 2025
 */

/** REQUIRED HEADER FILES */
#include <zephyr/device.h>
#include <zephyr/kernel.h>
#include <zephyr/logging/log.h>
#include <zephyr/fs/fs.h>
#include <zephyr/fs/littlefs.h>
#include <zephyr/storage/flash_map.h>

#include "sensor_structures.h"

/** MACRO DEFINITIONS */
#define LOGGER_THREAD_STACK_SIZE 1024 * 4
#define LOGGER_THREAD_PRIORITY   5
#define LOGGER_THREAD_SLEEP_TIME K_SECONDS(30)

#define QUEUE_TIMEOUT K_MSEC(1000)

#define STORAGE_PARTITION_LABEL storage_partition
#define MOUNT_POINT             "/lfs"

/** LOGGING CONFIGURATION */
/* Register the logging module for sensor logger operations. */
LOG_MODULE_REGISTER(sensor_logger);

/* Message queue to receive humidity data from the humidity sensor thread */
extern struct k_msgq humMsgQ;
extern struct k_msgq tempMsgQ;
extern struct k_msgq pressureMsgQ;
extern struct k_msgq imuMsgQ;

FS_LITTLEFS_DECLARE_DEFAULT_CONFIG(cstorage);

static struct fs_mount_t lfsMount = {
	.type = FS_LITTLEFS,
	.fs_data = &cstorage,
	.storage_dev = (void *)FIXED_PARTITION_ID(storage_partition),
	.mnt_point = MOUNT_POINT,
};

int loggerInit(void)
{
	/* 1. Try to mount */
	int rc = fs_mount(&lfsMount);
	if (rc == 0) {
		LOG_INF("Mounted LittleFS at %s", MOUNT_POINT);
		return 0;
	}

	/* 2. Unmount and retry to mount */
	LOG_WRN("Mount failed: %d. Attempting unmount and retry.", rc);
	fs_unmount(&lfsMount);

	rc = fs_mount(&lfsMount);
	if (rc == 0) {
		LOG_INF("Mounted LittleFS at %s", MOUNT_POINT);
		return 0;
	}

	/* 3. Erase flash and mount */
	LOG_WRN("Mount failed again: %d. Formatting.", rc);

	const struct flash_area *pfa;
	rc = flash_area_open((uintptr_t)lfsMount.storage_dev, &pfa);
	if (rc < 0) {
		LOG_ERR("Failed to open flash area: %d", rc);
		return rc;
	}

	rc = flash_area_erase(pfa, 0, pfa->fa_size);
	flash_area_close(pfa);
	if (rc < 0) {
		LOG_ERR("Flash erase failed: %d", rc);
		return rc;
	}

	LOG_INF("Flash erased, retrying mount");

	rc = fs_mount(&lfsMount);
	if (rc < 0) {
		LOG_ERR("Mount failed after erase: %d", rc);
		return rc;
	}

	LOG_INF("Mounted LittleFS at %s", MOUNT_POINT);
	return 0;
}

int writeSensorData(sensorSharedBuffer_t *data)
{
	struct fs_file_t file;
	fs_file_t_init(&file);

	int rc = fs_open(&file, "/lfs/data.bin", FS_O_CREATE | FS_O_WRITE | FS_O_APPEND);
	if (rc < 0) {
		LOG_ERR("Failed to open data.bin (%d)", rc);
		return rc;
	}

	rc = fs_write(&file, data, sizeof(sensorSharedBuffer_t));
	if (rc < 0) {
		LOG_ERR("Failed to write to data.bin (%d)", rc);
	}

	fs_close(&file);
	fs_sync(&file);

	return rc;
}

void printData(sensorSharedBuffer_t *data)
{
	LOG_INF("Humidity: %.2f %%", data->humidityData.dHumidity);
	LOG_INF("Temperature: %.2f C", data->temperatureData.dTemperature);
	LOG_INF("Pressure: %.2f hPa", data->pressureData.dPressure);
	LOG_INF("Accelerometer: X=%.2f Y=%.2f Z=%.2f", data->motionData.accel.x,
		data->motionData.accel.y, data->motionData.accel.z);
	LOG_INF("Gyroscope: X=%.2f Y=%.2f Z=%.2f", data->motionData.gyro.x, data->motionData.gyro.y,
		data->motionData.gyro.z);
}

/*
 * @brief loggerThread - Logger thread to log sensor data.
 *
 * @author Dhruv Mamtora
 * @date 26 August, 2025
 *
 * @details
 * This thread continuously receives sensor data from the humidity sensor thread via a message
 * queue and logs the received data.
 *
 * @pre The humidity sensor thread must be running and sending data to the message queue.
 *
 * @syntax
 * void loggerThread(void *a, void *b, void *c);
 *
 * @param[in] a Unused parameter.
 * @param[in] b Unused parameter.
 * @param[in] c Unused parameter.
 *
 * @return None.
 */
void loggerThread(void *a, void *b, void *c)
{
	loggerInit();
	sensorSharedBuffer_t localBuffer;
	LOG_INF("Logger thread started.");

	while (1) {
		k_msgq_get(&humMsgQ, &localBuffer.humidityData, QUEUE_TIMEOUT);
		k_msgq_get(&tempMsgQ, &localBuffer.temperatureData, QUEUE_TIMEOUT);
		k_msgq_get(&pressureMsgQ, &localBuffer.pressureData, QUEUE_TIMEOUT);
		k_msgq_get(&imuMsgQ, &localBuffer.motionData, QUEUE_TIMEOUT);

		/* Log the received sensor data */
		printData(&localBuffer);

		writeSensorData(&localBuffer);
		k_sleep(LOGGER_THREAD_SLEEP_TIME);
	}
}

/* Define the stack and thread for the logger thread. */
K_THREAD_DEFINE(loggerThreadId, LOGGER_THREAD_STACK_SIZE, loggerThread, NULL, NULL, NULL,
		LOGGER_THREAD_PRIORITY, 0, 1500);
```

## src/sensor_structures.h
```c
/*
 * @file shared_data.h
 * @author Dhruv Mamtora
 * @version 0.1.0
 * @date  21 August, 2025
 *
 * @brief Shared data structures for sensor data.
 *
 * @details
 * This header file defines the data structures used to store and share sensor data
 * between different threads in the Sensor Data Logging System.
 *
 * @copyright Copyright (c) 2025
 */

#ifndef SENSOR_STRUCTURES_H
#define SENSOR_STRUCTURES_H

typedef struct {
	double dHumidity;
} humidityData_t;

typedef struct {
	double dTemperature;
} temperatureData_t;

typedef struct {
	double dPressure;
} pressureData_t;

/* Define a vector structure to hold accelerometer and gyroscope data */
typedef struct {
	double x, y, z;
} vector_t;

typedef struct {
	vector_t accel;
	vector_t gyro;
} motionData_t;

/* Structure to hold the latest sensor values */
typedef struct {
	humidityData_t humidityData;
	temperatureData_t temperatureData;
	pressureData_t pressureData;
	motionData_t motionData;
} sensorSharedBuffer_t;

#endif /* SENSOR_STRUCTURES_H */
```
